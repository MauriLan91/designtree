## app/e2e/fixtures/linux/Documentation/devicetree/bindings/mfd/airoha,scu.yaml
```yaml
%YAML 1.2
---
$id: http://devicetree.org/schemas/mfd/airoha,scu.yaml#
$schema: http://devicetree.org/meta-schemas/core.yaml#

title: Airoha Chip SCU

properties:
  compatible:
    items:
      - const: airoha,scu
      - const: syscon

required:
  - compatible
```
